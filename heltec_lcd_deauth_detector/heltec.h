
#define LCD
#define LCDCLOCK 5
#define LCDDATA 4
#define LCDRESET 16


#include <U8g2lib.h>
//U8g2 Contructor
U8G2_SSD1306_128X32_UNIVISION_F_SW_I2C u8g2(U8G2_R0, /* clock=*/ LCDCLOCK, /* data=*/ LCDDATA, /* reset=*/ LCDRESET);
// Alternative board version. Uncomment if above doesn't work.
// U8G2_SSD1306_128X32_UNIVISION_F_SW_I2C u8g2(U8G2_R0, /* clock=*/ 14, /* data=*/ 2, /* reset=*/ 4);
#define U8G2_16BIT
u8g2_uint_t offset;     // current offset for the scrolling text
u8g2_uint_t width;      // pixel width of the scrolling text (must be lesser than 128 unless U8G2_16BIT is defined
const char *text = "gShift   "; // scroll this text from right to left

String Line1="";
String Line2="";
String Line3="";
String Line4="";

const uint8_t* fontname = u8g2_font_profont10_mr;

void lcdgShift() {
 
u8g2_uint_t x;

  u8g2.firstPage();
  do {

    // draw the scrolling text at current offset
    x = offset;
    u8g2.setFont(u8g2_font_logisoso20_tf);   // set the target font
    do {                // repeated drawing of the scrolling text...
      u8g2.drawUTF8(x, 32, text);     // draw the scolling text
      x += width;           // add the pixel width of the scrolling text
    } while ( x < u8g2.getDisplayWidth() );   // draw again until the complete display is filled

    u8g2.setFont(u8g2_font_logisoso20_tf);   // draw the current pixel width
    u8g2.setCursor(0, 64);
    u8g2.print(width);          // this value must be lesser than 128 unless U8G2_16BIT is set

  } while ( u8g2.nextPage() );

  offset -= 1;            // scroll by one pixel
  if ( (u8g2_uint_t)offset < (u8g2_uint_t) - width )
    offset = 0;             // start over again
  
}

void  heltecLCDsetup(){
  u8g2.begin();
 // u8g2.setFont(u8g2_font_logisoso20_tf); // set the target font to calculate the pixel width
  u8g2.setFont(fontname); // set the target font to calculate the pixel width
  width = u8g2.getUTF8Width(text);    // calculate the pixel width of the text
  u8g2.setFontMode(0);    // enable transparent mode, which is faster

  u8g2.clearBuffer();

  }

void heltecClear(){
   Line1="";
     Line2="";
     Line3="";
     Line4="";
    u8g2.clear();
}
 void heltecDisplayHostInfo(const char* Hostname, String HostIP,const char* MQTTin, const char* MQTTout){

  char HostnameCharBuf[25];
  char IPCharBuf[26];
  char MINCharBuf[25];
  char MOUTCharBuf[25];
 // u8g.clear();
  u8g2.firstPage();
  do {
    u8g2.setFont(fontname);
    String HOST = "Host:[ ";
    HOST += Hostname;;
       HOST += "     ]";;
    HOST.toCharArray(HostnameCharBuf,HOST.length()+1);
//
    String IP = "IP: [ ";
    IP += HostIP;;
       IP += " ]";;
       Serial.println(IP);
    IP.toCharArray(IPCharBuf,IP.length()+1);

    String Min = "MIn: [ ";
    Min += MQTTin;;
       Min += "  ]";;
    Min.toCharArray(MINCharBuf,Min.length()+1);

    String Mout = "HOut:[ ";
     Mout += MQTTout;;
       Mout += " ]";;
    Mout.toCharArray(MOUTCharBuf,Mout.length()+1);

    u8g2.drawStr(0,8,HostnameCharBuf);
    u8g2.drawStr(0,16,IPCharBuf);
    u8g2.drawStr(0,24,MINCharBuf);
    u8g2.drawStr(0,32,MOUTCharBuf);
//    u8g2.drawStr(0,16,sprintf("IP:[%s]",IP));
//    u8g2.drawStr(0,24,sprintf("MOut:[%s]",MQTTout));
//    u8g2.drawStr(0,32,sprintf("MIn:[%s]",MQTTin));
  } while ( u8g2.nextPage() );
}
void heltecDisplayMsg(String msg,int sleep,int line,bool clear,bool rotatetop,bool rotatebottom){

     curTime = millis();
     
     if ((curTime - prevTime) < 200) {
      //skip if to fast - WTD resets if you run this to fast based on a lot of incoming packets
     
      return;
     }
     prevTime = curTime;
      
  char msgbuf1[24];
  char msgbuf2[24];
  char msgbuf3[24];
  char msgbuf4[24];
   if (clear){
     Line1="";
     Line2="";
     Line3="";
     Line4="";
   }
   if (rotatetop) {
      Line4=Line3;
      Line3=Line2;
      Line2=Line1;
   }
   if (rotatebottom){
    Line1=Line2;
    Line2=Line3;
    Line3=Line4;
   }

   if (line == 1)
    Line1=msg;
   if (line == 2)
    Line2=msg;
   if (line == 3)
    Line3=msg;
   if (line == 4)
    Line4=msg;

//    Serial.print("Msg:[");
//    Serial.print(msg);
//    Serial.println("]");
    
  u8g2.firstPage();
  do {
   // u8g2.setFont(u8g2_font_profont10_mr);
   u8g2.setFont(fontname);
    Line1.toCharArray(msgbuf1,Line1.length()+1);
//    Serial.print("Line1:[");
//    Serial.print(msgbuf1);
//    Serial.println("]");
//    msgbuf1[Line1.length()]='\0';
    u8g2.drawStr(0,8,msgbuf1);
    Line2.toCharArray(msgbuf2,Line2.length()+1);
    u8g2.drawStr(0,16,msgbuf2);
    Line3.toCharArray(msgbuf3,Line3.length()+1);
    u8g2.drawStr(0,24,msgbuf3);
    Line4.toCharArray(msgbuf4,Line4.length()+1);
    u8g2.drawStr(0,32,msgbuf4);

    
  } while ( u8g2.nextPage() );
  delay(sleep);
}
void heltecDisplayMsg(String msg,int sleep){
    
  char msgbuf[msg.length()];
 
u8g2.clearBuffer();
    
  u8g2.firstPage();
  do {
    u8g2.setFont(fontname);
    Line1.toCharArray(msgbuf,msg.length()+1);
    u8g2.drawStr(0,8,msgbuf);
  } while ( u8g2.nextPage() );
  delay(sleep);
}

  
  void heltecDrawBC() {

  
  #define u8g_logo_width 128
#define u8g_logo_height 32
static unsigned char LCD_Logo_bits[] = {
   0x00, 0x00, 0x10, 0x00, 0x00, 0x00, 0x00, 0x00, 0x00, 0x00, 0x00, 0x00,
   0x00, 0x00, 0x00, 0x00, 0x00, 0x00, 0xf0, 0x00, 0x00, 0x00, 0x00, 0x00,
   0x00, 0x00, 0x00, 0x00, 0x00, 0x00, 0x00, 0x00, 0x00, 0x00, 0xc0, 0x03,
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   0x00, 0x00, 0x00, 0x00, 0x38, 0x00, 0x00, 0x00 };


u8g2.firstPage();
do {
 u8g2.drawXBM( 0, 0, u8g_logo_width, u8g_logo_height, LCD_Logo_bits);
} while( u8g2.nextPage() );
delay(3000);
}

